## conf/layer.conf
```bitbake
# We have a conf and classes directory, add to BBPATH
BBPATH .= ":${LAYERDIR}"

# We have recipes-* directories, add to BBFILES
BBFILES += "${LAYERDIR}/recipes-*/*/*.bb \
            ${LAYERDIR}/recipes-*/*/*.bbappend"

BBFILE_COLLECTIONS += "meta-iot-server"
BBFILE_PATTERN_meta-iot-server = "^${LAYERDIR}/"
BBFILE_PRIORITY_meta-iot-server = "7"

LAYERDEPENDS_meta-iot-server = "core"
LAYERSERIES_COMPAT_meta-iot-server = "dunfell"
```
